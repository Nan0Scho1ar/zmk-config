## boards/shields/sodapop/Kconfig.defconfig
```kconfig
if SHIELD_SODAPOP_LEFT

config ZMK_KEYBOARD_NAME
    default "sodapop"

config ZMK_SPLIT_ROLE_CENTRAL
    default y

endif # SHIELD_SODAPOP_LEFT

if SHIELD_SODAPOP_LEFT || SHIELD_SODAPOP_RIGHT

config ZMK_SPLIT
    default y

endif # SHIELD_SODAPOP_LEFT || SHIELD_SODAPOP_RIGHT
```

## boards/shields/sodapop/Kconfig.shield
```kconfig
config SHIELD_SODAPOP_LEFT
    def_bool $(shields_list_contains,sodapop_left)

config SHIELD_SODAPOP_RIGHT
    def_bool $(shields_list_contains,sodapop_right)
```
