## boards/shields/n0s1/Kconfig.defconfig
```kconfig
if SHIELD_N0S1_LEFT

config ZMK_KEYBOARD_NAME
    default "n0s1"

config ZMK_SPLIT_ROLE_CENTRAL
    default y

endif # SHIELD_N0S1_LEFT

if SHIELD_N0S1_LEFT || SHIELD_N0S1_RIGHT

config ZMK_SPLIT
    default y

endif # SHIELD_N0S1_LEFT || SHIELD_N0S1_RIGHT
```

## boards/shields/n0s1/Kconfig.shield
```kconfig
config SHIELD_N0S1_LEFT
    def_bool $(shields_list_contains,n0s1_left)

config SHIELD_N0S1_RIGHT
    def_bool $(shields_list_contains,n0s1_right)
```

## boards/shields/wavelength/Kconfig.defconfig
```kconfig
if SHIELD_WAVELENGTH

config ZMK_KEYBOARD_NAME
    default "wavelength"

endif # SHIELD_WAVELENGTH
```
